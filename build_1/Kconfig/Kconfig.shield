## build_1/Kconfig/Kconfig.shield
```kconfig
osource "c:/games/custom_nrf/boards/shields/*/Kconfig.shield"
osource "C:/ncs/v2.6.1/nrf/boards/shields/*/Kconfig.shield"
```

## build_1/Kconfig/Kconfig.shield.defconfig
```kconfig
osource "c:/games/custom_nrf/boards/shields/*/Kconfig.defconfig"
osource "C:/ncs/v2.6.1/nrf/boards/shields/*/Kconfig.defconfig"
```
